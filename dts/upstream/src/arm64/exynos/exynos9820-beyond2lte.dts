// SPDX-License-Identifier: GPL-2.0 OR BSD-3-Clause
/*
 * Samsung Galaxy S10+ (beyond2lte/SM-G975F) device tree source
 *
 * Copyright (c) 2026 chiffathefox <chiffathefoxx@gmail.com>
 */

/dts-v1/;
#include "exynos9820-common.dtsi"

/ {
	model = "Samsung Galaxy S10+ (SM-G975F)";
	compatible = "samsung,beyond2lte", "samsung,exynos9820";
	chassis-type = "handset";
};
